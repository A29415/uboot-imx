## board/nxp/mx6ull_atk_emmc/Kconfig
```kconfig
if TARGET_MX6ULL_14X14_ATK_EMMC

config SYS_BOARD
	default "mx6ull_atk_emmc"

config SYS_VENDOR
	default "nxp"

config SYS_CONFIG_NAME
	default "mx6ull_atk_emmc"

config IMX_CONFIG
	default "board/nxp/mx6ull_atk_emmc/imximage.cfg"

config TEXT_BASE
	default 0x87800000
endif
```
